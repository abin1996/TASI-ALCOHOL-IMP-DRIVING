VERSION ""

NS_ :

BS_:

BU_:

BO_ 35 YGS1S02: 7 Vector__XXX
 SG_ GL2 : 17|10@0+ (0.03589,-18.375) [0|0] "m/s^2" Vector__XXX
 SG_ GL1 : 1|10@0+ (0.03589,-18.375) [0|0] "m/s^2" Vector__XXX

BO_ 34 YGS1S01: 8 Vector__XXX
 SG_ YR2 : 17|10@0+ (0.244,-125) [0|0] "deg/s" Vector__XXX
 SG_ YR1 : 1|10@0+ (0.244,-125) [0|0] "deg/s" Vector__XXX

BO_ 705 ENG1S01: 8 Vector__XXX
 SG_ EACCP : 55|8@0+ (0.5,0) [0|0] "%" Vector__XXX

BO_ 37 STR1S01: 8 Vector__XXX
 SG_ SSAZ : 19|12@0- (1.5,0) [0|0] "deg" Vector__XXX
 SG_ SSA : 3|12@0- (1.5,0) [0|0] "deg" Vector__XXX

BO_ 832 ENG1S05: 7 Vector__XXX
 SG_ WSTL : 39|1@0+ (1,0) [0|0] "" Vector__XXX
 SG_ VNCC : 23|16@0+ (0.00390625,0) [0|0] "km/h" Vector__XXX
